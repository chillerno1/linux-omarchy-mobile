## Documentation/devicetree/bindings/input/betterlife,bf83112.yaml
```yaml
# SPDX-License-Identifier: (GPL-2.0-only OR BSD-2-Clause)
%YAML 1.2
---
$id: http://devicetree.org/schemas/input/betterlife,bf83112.yaml#
$schema: http://devicetree.org/meta-schemas/core.yaml#

title: Betterlife BF83112 capacitive fingerprint sensor

maintainers:
  - chillerno1 <gh.chiller@pm.me>

description: |
  The BF83112 is a capacitive fingerprint sensor with an SPI interface, a
  reset input and an interrupt output.

  On the phones it is found in, the SPI interface is owned by the secure
  world: the trusted firmware drives the bus and reads the images, and the
  bus controller is not available to Linux. This node is therefore not a
  child of an SPI bus. It describes only the lines Linux drives: the
  supply, the reset line and the interrupt line.

properties:
  compatible:
    const: betterlife,bf83112

  interrupts:
    maxItems: 1
    description: Finger detect interrupt, active high.

  reset-gpios:
    maxItems: 1

  vcc-supply:
    description: Sensor supply.

  wakeup-source: true

required:
  - compatible
  - interrupts
  - reset-gpios
  - vcc-supply

additionalProperties: false

examples:
  - |
    #include <dt-bindings/gpio/gpio.h>
    #include <dt-bindings/interrupt-controller/irq.h>

    fingerprint {
        compatible = "betterlife,bf83112";
        interrupts-extended = <&tlmm 40 IRQ_TYPE_EDGE_RISING>;
        reset-gpios = <&tlmm 41 GPIO_ACTIVE_LOW>;
        vcc-supply = <&vreg_l11c_3p0>;
    };
```

## Documentation/devicetree/bindings/media/i2c/sony,imx481.yaml
```yaml
# SPDX-License-Identifier: (GPL-2.0-only OR BSD-2-Clause)
%YAML 1.2
---
$id: http://devicetree.org/schemas/media/i2c/sony,imx481.yaml#
$schema: http://devicetree.org/meta-schemas/core.yaml#

title: Sony IMX481 Image Sensor

maintainers:
  - chillerno1 <gh.chiller@pm.me>

description:
  The Sony IMX481 is a CMOS image sensor with a MIPI CSI-2 output,
  controlled through an I2C-compatible interface.

allOf:
  - $ref: /schemas/media/video-interface-devices.yaml#

properties:
  compatible:
    const: sony,imx481

  reg:
    maxItems: 1

  clocks:
    description: External clock (INCK), 24 MHz.
    maxItems: 1

  dovdd-supply:
    description: Interface (I/O) supply, 1.8 V.

  avdd-supply:
    description: Analog supply, 2.8 V.

  dvdd-supply:
    description: Digital core supply.

  reset-gpios:
    description: GPIO connected to the XCLR pin, active low.
    maxItems: 1

  power-domains:
    description:
      Power domain the external clock depends on, where the clock comes
      from a camera clock controller.
    maxItems: 1

  port:
    $ref: /schemas/graph.yaml#/$defs/port-base
    additionalProperties: false

    properties:
      endpoint:
        $ref: /schemas/media/video-interfaces.yaml#
        unevaluatedProperties: false

        properties:
          data-lanes:
            minItems: 1
            maxItems: 4

          link-frequencies: true

        required:
          - data-lanes
          - link-frequencies

required:
  - compatible
  - reg
  - clocks
  - dovdd-supply
  - avdd-supply
  - dvdd-supply

unevaluatedProperties: false

examples:
  - |
    #include <dt-bindings/gpio/gpio.h>

    i2c {
        #address-cells = <1>;
        #size-cells = <0>;

        camera@1a {
            compatible = "sony,imx481";
            reg = <0x1a>;

            clocks = <&cam_mclk>;
            assigned-clocks = <&cam_mclk>;
            assigned-clock-rates = <24000000>;

            dovdd-supply = <&vreg_dovdd>;
            avdd-supply = <&vreg_avdd>;
            dvdd-supply = <&vreg_dvdd>;

            reset-gpios = <&tlmm 118 GPIO_ACTIVE_LOW>;

            orientation = <0>;
            rotation = <90>;
        };
    };
...
```

## Documentation/devicetree/bindings/media/i2c/sony,imx766.yaml
```yaml
# SPDX-License-Identifier: (GPL-2.0-only OR BSD-2-Clause)
%YAML 1.2
---
$id: http://devicetree.org/schemas/media/i2c/sony,imx766.yaml#
$schema: http://devicetree.org/meta-schemas/core.yaml#

title: Sony IMX766 Image Sensor

maintainers:
  - chillerno1 <gh.chiller@pm.me>

description:
  The Sony IMX766 is a 50 Mpixel (8192x6144) Quad Bayer CMOS image sensor
  with a MIPI CSI-2 output over three C-PHY trios, controlled through an
  I2C-compatible interface.

allOf:
  - $ref: /schemas/media/video-interface-devices.yaml#

properties:
  compatible:
    const: sony,imx766

  reg:
    maxItems: 1

  clocks:
    description: External clock (INCK), 24 MHz.
    maxItems: 1

  dovdd-supply:
    description: Interface (I/O) supply, 1.8 V.

  avdd-supply:
    description: Analog supply, 2.8 V.

  avdd2-supply:
    description: Second analog supply, 1.8 V.

  dvdd-supply:
    description: Digital core supply.

  reset-gpios:
    description: GPIO connected to the XCLR pin, active low.
    maxItems: 1

  power-domains:
    description:
      Power domain the external clock depends on, where the clock comes
      from a camera clock controller.
    maxItems: 1

  port:
    $ref: /schemas/graph.yaml#/$defs/port-base
    additionalProperties: false

    properties:
      endpoint:
        $ref: /schemas/media/video-interfaces.yaml#
        unevaluatedProperties: false

        properties:
          bus-type:
            const: 1 # MEDIA_BUS_TYPE_CSI2_CPHY

          data-lanes:
            description: The three C-PHY trios.
            items:
              - const: 1
              - const: 2
              - const: 3

          link-frequencies:
            description:
              Half the C-PHY symbol rate per trio. Each sensor mode needs
              its own frequency; modes whose frequency is not listed are
              not available.

        required:
          - bus-type
          - data-lanes
          - link-frequencies

required:
  - compatible
  - reg
  - clocks
  - dovdd-supply
  - avdd-supply
  - avdd2-supply
  - dvdd-supply
  - port

unevaluatedProperties: false

examples:
  - |
    #include <dt-bindings/gpio/gpio.h>
    #include <dt-bindings/media/video-interfaces.h>

    i2c {
        #address-cells = <1>;
        #size-cells = <0>;

        camera@29 {
            compatible = "sony,imx766";
            reg = <0x29>;

            clocks = <&cam_mclk>;
            assigned-clocks = <&cam_mclk>;
            assigned-clock-rates = <24000000>;

            dovdd-supply = <&vreg_dovdd>;
            avdd-supply = <&vreg_avdd>;
            avdd2-supply = <&vreg_avdd2>;
            dvdd-supply = <&vreg_dvdd>;

            reset-gpios = <&tlmm 24 GPIO_ACTIVE_LOW>;

            orientation = <1>;

            port {
                endpoint {
                    remote-endpoint = <&csiphy1_ep>;
                    bus-type = <MEDIA_BUS_TYPE_CSI2_CPHY>;
                    data-lanes = <1 2 3>;
                    link-frequencies = /bits/ 64 <431000000 574000000>;
                };
            };
        };
    };
...
```
